## components/Kconfig
```kconfig
menu "DuLion Tech Components"
    rsource "network/Kconfig.in"
    rsource "provision/Kconfig.in"
endmenu
```

## components/dlt/Kconfig
```kconfig
menu "DuLion Tech Components"
    rsource "../dlt_network/Kconfig.in"
    rsource "../dlt_wifi/Kconfig.in"
endmenu
```

## components/dlt_wifi/Kconfig.in
```kconfig
config DLT_WIFI
    bool "Enable WIFI with provisioning"
    select BT_ENABLE
    select ESP_PROTOCOMM_SUPPORT_SECURITY_VERSION_2
    select BT_BLE_42_FEATURES_SUPPORTED
    depends on !BT_BLE_50_FEATURES_SUPPORTED
    default n
    help
        Enable this option to support WIFI with Bluetooth provisioning.
```

## components/network/Kconfig.in
```kconfig
config DT_NETWORK_SUPPORT
    bool "Enable network support"
    default n
    help
        Enable this option to support network devices.
if DT_NETWORK_SUPPORT
    choice DT_NETWORK_SELECT
        prompt "Network component"
        default DT_NETWORK_PROVISION
        help
            Choose the network device you want to support.
        config DT_NETWORK_PROVISION
            bool "Provisioning"
            select DT_PROVISION
            help
                Enable this option to support device network provisioning
        config DT_NETWORK_QEMU
            bool "QEMU"
            help
                Enable this option to support QEMU network connectivity
    endchoice
endif
```

## components/provision/Kconfig.in
```kconfig
config DT_PROVISION
    bool "Enable provisioning"
    select BT_ENABLE
    select ESP_PROTOCOMM_SUPPORT_SECURITY_VERSION_2
    select BT_BLE_42_FEATURES_SUPPORTED
    depends on !BT_BLE_50_FEATURES_SUPPORTED
    default n
    help
        Enable this option to support network provisioning.
```
